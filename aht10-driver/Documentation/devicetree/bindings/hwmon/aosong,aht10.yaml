## aht10-driver/Documentation/devicetree/bindings/hwmon/aosong,aht10.yaml
```yaml
# SPDX-License-Identifier: GPL-2.0-only OR BSD-2-Clause
%YAML 1.2
---
$id: http://devicetree.org/schemas/hwmon/aosong,aht10.yaml#
$schema: http://devicetree.org/meta-schemas/core.yaml#

title: Aosong AHT10 Temperature and Humidity Sensor bindings

maintainers:
  - jcdra1@gmail.com

description: |
    Bindings description for the Aosong AHT10 temperature
    and humidity sensor.

properties:
  compatible:
    enum:
      - aosong,aht10

  reg:
    maxItems: 1
    description: The i2c address of the AHT10, which must be set to 0x38

required:
  - compatible
  - reg

additionalProperties: false

examples:
  - |
    i2c-1 {
      aht10_i2c1: ath10@0x38 {
        compatible = "aosong,aht10";
        reg = <0x38>;
      };
    };
...
```

## aht10-driver/drivers/hwmon/Kconfig.part
```kconfig
config SENSORS_ADT7475
    tristate "Analog Devices ADT7473, ADT7475, ADT7476 and ADT7490"
    depends on I2C
    select HWMON_VID
    help
      If you say yes here you get support for the Analog Devices
      ADT7473, ADT7475, ADT7476 and ADT7490 hardware monitoring
      chips.

      This driver can also be built as a module. If so, the module
      will be called adt7475.

config SENSORS_AHT10
    tristate "Aosong AHT10"
    depends on I2C
    help
      If you say yes here, you get support for the Aosong AHT10
      temperature and humidity sensors

      This driver can also be built as a module. If so, the module
      will be called aht10.

config SENSORS_AS370
    tristate "Synaptics AS370 SoC hardware monitoring driver"
    help
      If you say yes here you get support for the PVT sensors of
      the Synaptics AS370 SoC

      This driver can also be built as a module. If so, the module
      will be called as370-hwmon.
```
